/***************************飞音云电子****************************
**  工程名称:串口通讯函数
**	CPU: STC89LE52
**	晶振：22.1184MHZ
**	波特率：9600 bit/S
**	配套产品信息：XFS5051语音合成模块
**                http://yuesheng001.taobao.com
**  作者：zdings
**  联系：751956552@qq.com
**  修改日期：2012.12.23
**  说明：
/***************************飞音云电子******************************/
#include "config.h"

/************************************************************************
函 数 名： 串口初始化
功能描述： STC89LE52单片机串口初始化函数
返回函数： none
其他说明： none
**************************************************************************/
void UartIni(void)
{
	
	SCON = 0x50 ; //SCON: serail mode 1, 8-bit UART, enable ucvr  
	
	TMOD |= 0x20 ; //TMOD: timer 1, mode 2, 8-bit reload 
	
	PCON |= 0x80 ; //SMOD=1; 
	
	TH1 = 0xF4 ; //Baud:9600 fosc=22.1148MHz 
	
	IE |= 0x90 ; //Enable Serial Interrupt 
	
	TR1 = 1 ; // timer 1 run 
	ES=1;
	EA=1;
}

/***********************************************************
* 名    称： 串口接收中断
* 功    能： 
* 入口参数： 无 
* 出口参数：无
* 说    明： 					 
**********************************************************/
void Uart_Isr() interrupt 4 using 1
{	
	if(RI)
	{	
		ES=0;
		RI=0;
		ES=1;
	}

}
/************************************************************************
功能描述： 	串口发送一字节数据
入口参数：	DAT:带发送的数据
返 回 值： 	none
其他说明：	none
**************************************************************************/
void UARTSendByte(uint8_t DAT)
{
	ES  =  0;
	TI=0;
	SBUF = DAT;
	while(TI==0);
	TI=0;
	ES = 1;
}

/************************************************************************
功能描述： 串口发送字符串数据
入口参数： 	*DAT：字符串指针
返 回 值： none
其他说明： API 供外部使用，直观！
**************************************************************************/
void PrintCom(uint8_t *DAT,uint8_t len)
{
	uint8_t i;
	for(i=0;i<len;i++)
	{
	 	UARTSendByte(*DAT++);
	}	
}

